/ {

    // NOT WORKING ON ESP32 
    // need to use dtsi as reference for the source code

    aliases {
        led0 = &green_led_0;
    };

    green_led_0: led_0 {
        compatible = "gpio-leds";
        gpios = <&gpio0 2 GPIO_ACTIVE_HIGH>;
        status = "okay";
    };
};
