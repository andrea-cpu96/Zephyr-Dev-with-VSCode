## 1-envirorment-setup/build/Kconfig/boards/Kconfig
```kconfig
# Load Zephyr board Kconfig descriptions.
osource "/home/andrea/zephyrproject/zephyr/boards/st/stm32f411e_disco/Kconfig"
```

## 1-envirorment-setup/build/Kconfig/boards/Kconfig.defconfig
```kconfig
# Load Zephyr board defconfig descriptions.
osource "/home/andrea/zephyrproject/zephyr/boards/st/stm32f411e_disco/Kconfig.defconfig"
```

## 1-envirorment-setup/build/Kconfig/boards/Kconfig.stm32f411e_disco
```kconfig
# Load board Kconfig descriptions.
osource "/home/andrea/zephyrproject/zephyr/boards/st/stm32f411e_disco/Kconfig.stm32f411e_disco"
```

## 1-envirorment-setup/build/Kconfig/boards/Kconfig.sysbuild
```kconfig
# Load Sysbuild board Kconfig descriptions.
osource "/home/andrea/zephyrproject/zephyr/boards/st/stm32f411e_disco/Kconfig.sysbuild"
```
